## config/west.yml
```yaml
manifest:
  remotes:
    - name: zmkfirmware
      url-base: https://github.com/zmkfirmware
    - name: badjeff
      url-base: https://github.com/badjeff
  projects:
    - name: zmk
      remote: zmkfirmware
      revision: 4ec69cb7e658590adf6354027aca789b364a70c5
      import: app/west.yml
    - name: zmk-pmw3610-driver
      remote: badjeff
      revision: 77635bad95097e2ed6fc16624622cff025a0e33b
    - name: zmk-split-peripheral-input-relay
      remote: badjeff
      revision: main
    - name: zmk-input-behavior-listener
      remote: badjeff
      revision: main
  self:
    path: config
```
